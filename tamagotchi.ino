#include <Adafruit_SSD1327.h>

// Screen pins
#define OLED_CS 2
#define OLED_DC 4
#define OLED_RESET 3

Adafruit_SSD1327 display(128, 128, &SPI, OLED_DC, OLED_RESET, OLED_CS);

// Button pins
#define BUTTON_LEFT 9
#define BUTTON_CENTER 1
#define BUTTON_RIGHT 0


const unsigned char epd_bitmap_c1 [] PROGMEM = {
	0xff, 0xff, 0x00, 0x3f, 0xff, 0xff, 0xf8, 0x00, 0xff, 0xff, 0xff, 0xff, 0x00, 0x3f, 0xff, 0xff, 
	0xf8, 0x00, 0xff, 0xff, 0xff, 0xff, 0x00, 0x3f, 0xff, 0xff, 0xf8, 0x00, 0xff, 0xff, 0xff, 0xff, 
	0x00, 0x3f, 0xff, 0xff, 0xf8, 0x00, 0xff, 0xff, 0xff, 0xff, 0x00, 0x3f, 0xff, 0xff, 0xf8, 0x00, 
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	0xff, 0xff, 0xff, 0xff, 0xff, 0xff, 0xff, 0xff, 0xff, 0xc0, 0xff, 0xff, 0xff, 0xff, 0xff, 0xff
};
const unsigned char epd_bitmap_c2 [] PROGMEM = {
	0xff, 0xff, 0x00, 0x3f, 0xff, 0xff, 0xf8, 0x00, 0xff, 0xff, 0xff, 0xff, 0x00, 0x3f, 0xff, 0xff, 
	0xf8, 0x00, 0xff, 0xff, 0xff, 0xff, 0x00, 0x3f, 0xff, 0xff, 0xf8, 0x00, 0xff, 0xff, 0xff, 0xff, 
	0x00, 0x3f, 0xff, 0xff, 0xf8, 0x00, 0xff, 0xff, 0xff, 0xff, 0x00, 0x3f, 0xff, 0xff, 0xf8, 0x00, 
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	0xff, 0xff, 0x07, 0xff, 0xff, 0xff, 0xff, 0xff, 0xff, 0xff, 0xff, 0xff, 0x07, 0xff, 0xff, 0xff
};

const unsigned char epd_bitmap_l2 [] PROGMEM = {
	0xff, 0xff, 0xff, 0x07, 0xff, 0xff, 0xff, 0x07, 0xff, 0xff, 0xff, 0xff, 0xff, 0x07, 0xff, 0xff, 
	0xff, 0x07, 0xff, 0xff, 0xff, 0xff, 0xff, 0x07, 0xff, 0xff, 0xff, 0x07, 0xff, 0xff, 0xff, 0xff, 
	0xff, 0x07, 0xff, 0xff, 0xff, 0x07, 0xff, 0xff, 0xff, 0xff, 0xff, 0x07, 0xff, 0xff, 0xff, 0x07, 
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	0x1f, 0xff, 0xe0, 0xff, 0xff, 0xff, 0xff, 0xff, 0xff, 0xf8, 0x1f, 0xff, 0xe0, 0xff, 0xff, 0xff
};

const unsigned char epd_bitmap_l3 [] PROGMEM = {
	0xff, 0xfe, 0x00, 0x3f, 0xff, 0xff, 0xf8, 0x01, 0xff, 0xff, 0xff, 0xfe, 0x00, 0x3f, 0xff, 0xff, 
	0xf8, 0x01, 0xff, 0xff, 0xff, 0xfe, 0x00, 0x3f, 0xff, 0xff, 0xf8, 0x01, 0xff, 0xff, 0xff, 0xfe, 
	0x00, 0x3f, 0xff, 0xff, 0xf8, 0x01, 0xff, 0xff, 0xff, 0xfe, 0x00, 0x3f, 0xff, 0xff, 0xf8, 0x01, 
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	0xff, 0xfe, 0x07, 0xff, 0xff, 0xff, 0xff, 0xff, 0xff, 0xc1, 0xff, 0xfe, 0x07, 0xff, 0xff, 0xff
};

const unsigned char epd_bitmap_r1 [] PROGMEM = {
	0xff, 0xff, 0xff, 0xff, 0xe0, 0x03, 0xff, 0xff, 0xff, 0xff, 0xff, 0xff, 0xff, 0xff, 0xe0, 0x03, 
	0xff, 0xff, 0xff, 0xff, 0xff, 0xff, 0xff, 0xff, 0xe0, 0x03, 0xff, 0xff, 0xff, 0xff, 0xff, 0xff, 
	0xff, 0xff, 0xe0, 0x03, 0xff, 0xff, 0xff, 0xff, 0xff, 0xff, 0xff, 0xff, 0xe0, 0x03, 0xff, 0xff, 
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	0x1f, 0xfc, 0x1f, 0xff, 0xff, 0xff, 0xff, 0xff, 0xff, 0xfc, 0x1f, 0xfc, 0x1f, 0xff, 0xff, 0xff
};

const unsigned char epd_bitmap_r2 [] PROGMEM = {
	0xff, 0xff, 0xff, 0xff, 0x00, 0x3f, 0xff, 0xff, 0xff, 0xff, 0xff, 0xff, 0xff, 0xff, 0x00, 0x3f, 
	0xff, 0xff, 0xff, 0xff, 0xff, 0xff, 0xff, 0xff, 0x00, 0x3f, 0xff, 0xff, 0xff, 0xff, 0xff, 0xff, 
	0xff, 0xff, 0x00, 0x3f, 0xff, 0xff, 0xff, 0xff, 0xff, 0xff, 0xff, 0xff, 0x00, 0x3f, 0xff, 0xff, 
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	0xf8, 0x3f, 0xff, 0xff, 0xff, 0xff, 0xff, 0xff, 0xf8, 0x3f, 0xf8, 0x3f, 0xff, 0xff, 0xff, 0xff
};

const unsigned char epd_bitmap_idle1 [] PROGMEM = {
	0xff, 0xff, 0x00, 0x3f, 0xff, 0xff, 0xf8, 0x00, 0xff, 0xff, 0xff, 0xff, 0x00, 0x3f, 0xff, 0xff, 
	0xf8, 0x00, 0xff, 0xff, 0xff, 0xff, 0x00, 0x3f, 0xff, 0xff, 0xf8, 0x00, 0xff, 0xff, 0xff, 0xff, 
	0x00, 0x3f, 0xff, 0xff, 0xf8, 0x00, 0xff, 0xff, 0xff, 0xff, 0x00, 0x3f, 0xff, 0xff, 0xf8, 0x00, 
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	0xff, 0xff, 0x07, 0xff, 0xff, 0xff, 0xff, 0xff, 0xff, 0xc1, 0xff, 0xff, 0x07, 0xff, 0xff, 0xff
};

const unsigned char epd_bitmap_idle2[] PROGMEM = {
	0xff, 0xff, 0x00, 0x3f, 0xff, 0xff, 0xf8, 0x00, 0xff, 0xff, 0xff, 0xff, 0x00, 0x3f, 0xff, 0xff, 
	0xf8, 0x00, 0xff, 0xff, 0xff, 0xff, 0x00, 0x3f, 0xff, 0xff, 0xf8, 0x00, 0xff, 0xff, 0xff, 0xff, 
	0x00, 0x3f, 0xff, 0xff, 0xf8, 0x00, 0xff, 0xff, 0xff, 0xff, 0x00, 0x3f, 0xff, 0xff, 0xf8, 0x00, 
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	0xff, 0xff, 0x07, 0xff, 0xff, 0xff, 0xff, 0xff, 0xff, 0xc1, 0xff, 0xff, 0x07, 0xff, 0xff, 0xff
};

const unsigned char epd_bitmap_idle3 [] PROGMEM = {
	0xff, 0xff, 0x00, 0x1f, 0xff, 0xff, 0xfc, 0x00, 0xff, 0xff, 0xff, 0xff, 0x00, 0x1f, 0xff, 0xff, 
	0xfc, 0x00, 0xff, 0xff, 0xff, 0xff, 0x00, 0x1f, 0xff, 0xff, 0xfc, 0x00, 0xff, 0xff, 0xff, 0xff, 
	0x00, 0x1f, 0xff, 0xff, 0xfc, 0x00, 0xff, 0xff, 0xff, 0xff, 0x00, 0x1f, 0xff, 0xff, 0xfc, 0x00, 
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	0xff, 0xff, 0x03, 0xff, 0xff, 0xff, 0xff, 0xff, 0xff, 0xe0, 0xff, 0xff, 0x03, 0xff, 0xff, 0xff
};

const unsigned char epd_bitmap_sleep [] PROGMEM = {
	0xff, 0xff, 0x00, 0x3f, 0xff, 0xff, 0xf8, 0x00, 0xff, 0xff, 0xff, 0xff, 0x00, 0x3f, 0xff, 0xff, 
	0xf8, 0x00, 0xff, 0xff, 0xff, 0xff, 0x00, 0x3f, 0xff, 0xff, 0xf8, 0x00, 0xff, 0xff, 0xff, 0xff, 
	0x00, 0x3f, 0xff, 0xff, 0xf8, 0x00, 0xff, 0xff, 0xff, 0xff, 0x00, 0x3f, 0xff, 0xff, 0xf8, 0x00, 
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	0xff, 0xff, 0x07, 0xff, 0xff, 0xff, 0xff, 0xff, 0xff, 0xc1, 0xff, 0xff, 0x07, 0xff, 0xff, 0xff
};

const unsigned char epd_icon_feed [] PROGMEM = {
	0xff, 0xff, 0xf0, 0xff, 0xff, 0xf0, 0xd5, 0xe3, 0xf0, 0xd5, 0xc1, 0xf0, 0xd5, 0xc1, 0xf0, 0xd5, 
	0x80, 0xf0, 0xc1, 0x80, 0xf0, 0xc1, 0xc1, 0xf0, 0xc1, 0xc1, 0xf0, 0xe3, 0xc1, 0xf0, 0xf3, 0xe7, 
	0xf0, 0xf3, 0xe7, 0xf0, 0xf3, 0xe7, 0xf0, 0xf3, 0xe7, 0xf0, 0xf3, 0xe3, 0xf0, 0xf3, 0xe3, 0xf0, 
	0xf3, 0xe3, 0xf0, 0xf3, 0xe3, 0xf0, 0xf3, 0xe3, 0xf0, 0xff, 0xff, 0xf0
};

const unsigned char epd_bitmap_wind [] PROGMEM = {
0xff, 0xff, 0xff, 0xfc, 0xff, 0xff, 0xff, 0xfc, 0xff, 0xff, 0xff, 0xfc, 0xff, 0xff, 0xf1, 0xfc, 
	0xff, 0xff, 0xc0, 0xfc, 0xff, 0xff, 0x84, 0x7c, 0xff, 0xff, 0x8e, 0x7c, 0xfe, 0x01, 0xc2, 0x7c, 
	0xfe, 0x0f, 0xe6, 0x7c, 0xff, 0xff, 0xfc, 0xfc, 0xfc, 0x00, 0x00, 0xfc, 0xfc, 0x00, 0x03, 0xfc, 
	0xff, 0xff, 0xff, 0xfc, 0xff, 0xf8, 0xff, 0xfc, 0xf8, 0x00, 0x3f, 0xfc, 0xff, 0xff, 0xff, 0xfc, 
	0xff, 0xff, 0xff, 0xfc, 0xff, 0xff, 0xff, 0xfc, 0xff, 0xff, 0xff, 0xfc, 0xff, 0xff, 0xff, 0xfc
};

const unsigned char epd_icon_sleep [] PROGMEM = {
	0xff, 0xff, 0xf0, 0xff, 0xff, 0xf0, 0xfe, 0x7f, 0xf0, 0xfc, 0x7f, 0xf0, 0xf8, 0x7f, 0xf0, 0xf8, 
	0x7f, 0xf0, 0xf0, 0x7f, 0xf0, 0xf0, 0x3f, 0xf0, 0xf0, 0x1f, 0xf0, 0xf0, 0x0f, 0xf0, 0xf8, 0x00, 
	0x70, 0xf8, 0x00, 0x70, 0xfc, 0x00, 0xf0, 0xfe, 0x01, 0xf0, 0xff, 0x87, 0xf0, 0xff, 0xff, 0xf0, 
	0xff, 0xff, 0xf0, 0xff, 0xff, 0xf0, 0xff, 0xff, 0xf0, 0xff, 0xff, 0xf0
};

const unsigned char epd_icon_exercise [] PROGMEM = {
	0xff, 0xff, 0xf0, 0xff, 0xff, 0xf0, 0xff, 0xff, 0xf0, 0xf8, 0xf1, 0xf0, 0xe0, 0x40, 0xf0, 0xe0, 
	0x00, 0x70, 0xc0, 0x00, 0x70, 0xc1, 0x80, 0x70, 0xc1, 0x90, 0x70, 0xe0, 0xb0, 0x70, 0xfe, 0x2f, 
	0xf0, 0xf0, 0x61, 0xf0, 0xf8, 0x43, 0xf0, 0xfc, 0x07, 0xf0, 0xfe, 0x0f, 0xf0, 0xff, 0x1f, 0xf0, 
	0xff, 0xff, 0xf0, 0xff, 0xff, 0xf0, 0xff, 0xff, 0xf0, 0xff, 0xff, 0xf0
};

const unsigned char epd_icon_scream [] PROGMEM =  {
	0xff, 0xff, 0xf0, 0xff, 0x8f, 0xf0, 0xff, 0x07, 0xf0, 0xff, 0x07, 0xf0, 0xff, 0x07, 0xf0, 0xff, 
	0x07, 0xf0, 0xff, 0x07, 0xf0, 0xff, 0x07, 0xf0, 0xff, 0x0f, 0xf0, 0xff, 0x8f, 0xf0, 0xff, 0x8f, 
	0xf0, 0xff, 0x8f, 0xf0, 0xff, 0x8f, 0xf0, 0xff, 0x9f, 0xf0, 0xff, 0xff, 0xf0, 0xff, 0xdf, 0xf0, 
	0xff, 0x8f, 0xf0, 0xff, 0x8f, 0xf0, 0xff, 0x9f, 0xf0, 0xff, 0xff, 0xf0
};


// --- Character Configuration ---
// Adjust these constants to match your new smaller assets!
const int ANIMAL_WIDTH  = 80;  
const int ANIMAL_HEIGHT = 80; 

// Amount of times an animation loops before it settles back into idle
const int requiredLoops = 3;
int z_counter = 0;


// --- Character Frames (Drawn on the top half) ---
const unsigned char* idleFrames[]   = { epd_bitmap_idle1, epd_bitmap_idle1, epd_bitmap_idle1, epd_bitmap_idle1,  epd_bitmap_idle1, epd_bitmap_idle1, epd_bitmap_idle1, epd_bitmap_idle2, epd_bitmap_idle2};
const unsigned char* exerciseFrames[] = { epd_bitmap_c1, epd_bitmap_c2 };
const unsigned char* windFrames[]   = { epd_bitmap_l2, epd_bitmap_l2, epd_bitmap_l2, epd_bitmap_l2, epd_bitmap_l2, epd_bitmap_l2, epd_bitmap_l2, epd_bitmap_l2, epd_bitmap_l2, epd_bitmap_l3,epd_bitmap_l3,epd_bitmap_l3,epd_bitmap_l3  };
const unsigned char* screamFrames[]  = { epd_bitmap_r1, epd_bitmap_r2 }; 
const unsigned char* sleepFrames[]  = {epd_bitmap_sleep, epd_bitmap_sleep, epd_bitmap_sleep, epd_bitmap_sleep, epd_bitmap_sleep, epd_bitmap_sleep}; 

const int TOTAL_IDLE_FRAMES   = sizeof(idleFrames) / sizeof(idleFrames[0]); // <-- NEW
const int TOTAL_EXERCISE_FRAMES = sizeof(exerciseFrames) / sizeof(exerciseFrames[0]);
const int TOTAL_SCREAM_FRAMES   = sizeof(screamFrames) / sizeof(screamFrames[0]);
const int TOTAL_WIND_FRAMES  = sizeof(windFrames) / sizeof(windFrames[0]);
const int TOTAL_SLEEP_FRAMES  = sizeof(sleepFrames) / sizeof(sleepFrames[0]);

const int NUM_Z_FRAMES = 6;
const int NUM_FIRST_Z = 2; 
const int NUM_SECOND_Z = 4; 

int wind_counter = 0;
const int NUM_WIND_START = 4;
const int NUM_WIND_STOP = 6;

// --- Menu Icons Configuration  ---
const unsigned char* menuIcons[] = { epd_icon_scream, epd_icon_sleep,  epd_icon_feed, epd_icon_exercise };
const int TOTAL_ICONS = sizeof(menuIcons) / sizeof(menuIcons[0]); 
const int ICON_WIDTH = 20;  
const int ICON_HEIGHT = 20;

// State Machines
enum TamagotchiState { 
  STATE_IDLE,  
  STATE_SCREAM, 
  STATE_EXERCISE, 
  STATE_WIND,
  STATE_SLEEP
};
TamagotchiState currentState = STATE_IDLE;

int currentFrame = 0;
int selectedIconIndex = 0;

// --- Millis Timing Constants ---
unsigned long lastRenderTime = 0;
const unsigned long RENDER_INTERVAL_MS = 200; 

// Button State Tracking
bool lastLeftState   = LOW;
bool lastCenterState = LOW;
bool lastRightState  = LOW;

void setup() {
  Serial.begin(115200);
  if (!display.begin(0x3D)) {
    Serial.println(F("SSD1327 setup failed"));
  }
  
  pinMode(BUTTON_LEFT, INPUT);
  pinMode(BUTTON_CENTER, INPUT);
  pinMode(BUTTON_RIGHT, INPUT);

  display.clearDisplay();
  display.setRotation(2);
  display.display();
}

void loop() {
  // 1. HIGH-SPEED BUTTON SCANNING
  bool currentLeft   = digitalRead(BUTTON_LEFT);
  bool currentCenter = digitalRead(BUTTON_CENTER);
  bool currentRight  = digitalRead(BUTTON_RIGHT);
  bool needsImmediateRefresh = false;

  if (currentLeft == HIGH && lastLeftState == LOW) {
    if (selectedIconIndex > 0) {
      selectedIconIndex--;
      needsImmediateRefresh = true; 
    }
  }
  else if (currentRight == HIGH && lastRightState == LOW) {
    if (selectedIconIndex < TOTAL_ICONS - 1) {
      selectedIconIndex++;
      needsImmediateRefresh = true; 
    }
  }
  else if (currentCenter == HIGH && lastCenterState == LOW) {
    if (selectedIconIndex == 0)      currentState = STATE_SCREAM;     
    else if (selectedIconIndex == 1) currentState = STATE_SLEEP;   
    else if (selectedIconIndex == 2) currentState = STATE_WIND;    
    else if (selectedIconIndex == 3) currentState = STATE_EXERCISE;    
    
    currentFrame = 0; 
    needsImmediateRefresh = true;
  }

  lastLeftState   = currentLeft;
  lastCenterState = currentCenter;
  lastRightState  = currentRight;

  // 2. RENDERING TIMING CONTROL
  unsigned long currentMillis = millis();
  
  if (currentMillis - lastRenderTime >= RENDER_INTERVAL_MS || needsImmediateRefresh) {
    if (!needsImmediateRefresh) {
      currentFrame++;
    }
    lastRenderTime = currentMillis; 

    // Clear the screen completely to a fresh white background
    display.fillScreen(SSD1327_WHITE); 

    // --- DRAW SEPARATOR LINE ---
    display.drawFastHLine(0, 96, 128, SSD1327_BLACK);

    // --- DRAW CHARACTER (Top Half) ---
    const unsigned char* frameToDraw = nullptr;
    int totalFrames = 0;

    if (currentState == STATE_IDLE) { // <-- NEW: Handles idle rendering
      totalFrames = TOTAL_IDLE_FRAMES;
      frameToDraw = idleFrames[currentFrame % totalFrames];
    } else if (currentState == STATE_EXERCISE) {
      totalFrames = TOTAL_EXERCISE_FRAMES;
      frameToDraw = exerciseFrames[currentFrame % totalFrames];
    } else if (currentState == STATE_SCREAM) {
      totalFrames = TOTAL_SCREAM_FRAMES;
      frameToDraw = screamFrames[currentFrame % totalFrames];
    } else if (currentState == STATE_WIND) {
      totalFrames = TOTAL_WIND_FRAMES;
      frameToDraw = windFrames[currentFrame % totalFrames];
    } else {
      totalFrames = TOTAL_SLEEP_FRAMES;
      frameToDraw = sleepFrames[currentFrame % totalFrames];
    }

    if (frameToDraw != nullptr) {
       int charX = (128 - ANIMAL_WIDTH) / 2;
       int charY = (96 - ANIMAL_HEIGHT) / 2; 
       
       display.drawBitmap(charX, charY, frameToDraw, ANIMAL_WIDTH, ANIMAL_HEIGHT, SSD1327_WHITE, SSD1327_BLACK);
			 
    }
		if (currentState == STATE_SLEEP) {
			display.setTextSize(2);
			display.setTextColor(SSD1327_BLACK);
			z_counter = z_counter % NUM_Z_FRAMES; 
			if (z_counter >= NUM_FIRST_Z){
				display.setCursor(100, 10); 
				display.print("z");

				if 	(z_counter >= NUM_SECOND_Z){		
					display.setCursor(110, 5); 
					display.print("z");
				}
			}
			z_counter += 1;
		}

			if (currentState == STATE_WIND) {

			wind_counter = wind_counter % TOTAL_WIND_FRAMES; 
			if (wind_counter >= NUM_WIND_START && wind_counter <= NUM_WIND_STOP){
				display.drawBitmap(97, 60, epd_bitmap_wind, 30, 20, SSD1327_WHITE, SSD1327_BLACK); // MAGIC NUMBERS, FIX
			}
			wind_counter += 1;


		}



    // --- DRAW MENU ICONS (Bottom Half) ---
    int menuY = 105; 
    int spacing = 128 / (TOTAL_ICONS + 1); 

    for (int i = 0; i < TOTAL_ICONS; i++) {
      int iconX = (spacing * (i + 1)) - (ICON_WIDTH / 2);
      
      if (i == selectedIconIndex) {
        display.drawBitmap(iconX, menuY, menuIcons[i], ICON_WIDTH, ICON_HEIGHT, SSD1327_BLACK, SSD1327_WHITE);
      } else {
        display.drawBitmap(iconX, menuY, menuIcons[i], ICON_WIDTH, ICON_HEIGHT, SSD1327_WHITE, SSD1327_BLACK);
      }
    }

    // --- DRAWING TEXT ("lab64") ---
    display.setTextSize(1);
    display.setTextColor(SSD1327_BLACK); 
    display.setCursor(5, 86); 
    display.print("lab64");

    display.display();

    if (currentFrame >= totalFrames * requiredLoops) {
      currentFrame = 0; 
      if (currentState != STATE_IDLE) {
         currentState = STATE_IDLE; // <-- Reverts back to IDLE STATE after animations finish
      }
    }
  }
}